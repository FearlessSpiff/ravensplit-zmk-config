## boards/shields/ravensplit/Kconfig.defconfig
```kconfig
if SHIELD_RAVENSPLIT_RIGHT

# Name must be less than 16 characters long!
config ZMK_KEYBOARD_NAME
    default "ravensplit"

config ZMK_SPLIT_ROLE_CENTRAL
    default y

config ZMK_POINTING
    default y

config SPI
    default y

config INPUT_PINNACLE
    default y

endif

if SHIELD_RAVENSPLIT_RIGHT || SHIELD_RAVENSPLIT_LEFT

config ZMK_SPLIT
    default y

endif
```
