#include "ravensplit.dtsi"

&kscan0 {
    col-gpios
        = <&pro_micro 8 GPIO_ACTIVE_HIGH> // C0
        , <&pro_micro 9 GPIO_ACTIVE_HIGH> // C1
        , <&pro_micro 10 GPIO_ACTIVE_HIGH> // C2
        , <&pro_micro 16 GPIO_ACTIVE_HIGH> // C3
        , <&pro_micro 14 GPIO_ACTIVE_HIGH> // C4
        , <&pro_micro 15 GPIO_ACTIVE_HIGH> // C5
        ;
};
